## esp32/uplink/main/Kconfig.projbuild
```kconfig
menu "FoF Uplink OLED"
    config FOF_OLED_SDA_PIN
        int "I2C SDA pin"
        default 4
    config FOF_OLED_SCL_PIN
        int "I2C SCL pin"
        default 5
    config FOF_OLED_RST_PIN
        int "OLED reset pin (-1 to disable)"
        default -1
endmenu

menu "FoF Inter-board Transport"
    config FOF_TRANSPORT_USB_PRIMARY
        bool "Prefer USB-CDC for scanner->uplink telemetry"
        default y

    config FOF_TRANSPORT_UART_FALLBACK
        bool "Allow UART fallback when USB transport is unavailable"
        default y
endmenu
```
